## CMakeLists.txt
```
cmake_minimum_required(VERSION 3.20.0)
find_package(Zephyr REQUIRED HINTS $ENV{ZEPHYR_BASE})
project(firmware)

set(TFLM_ROOT "${ZEPHYR_BASE}/../modules/tflite-micro")
set(CMSIS_ROOT "${ZEPHYR_BASE}/../modules/lib/cmsis-dsp")
set(CMSIS_NN_ROOT "${ZEPHYR_BASE}/../modules/lib/cmsis-nn") 
set(CMSIS_CORE "${ZEPHYR_BASE}/../modules/hal/cmsis")

target_include_directories(app PRIVATE 
    include
    "${TFLM_ROOT}"
    "${TFLM_ROOT}/third_party_static/flatbuffers/include"
    "${TFLM_ROOT}/third_party_static/gemmlowp"
    "${TFLM_ROOT}/third_party_static/kissfft"
    "${TFLM_ROOT}/third_party_static/ruy"
    "${TFLM_ROOT}/third_party_static/ruy/include"
    "${CMSIS_ROOT}/Include"
    "${CMSIS_NN_ROOT}"         
    "${CMSIS_NN_ROOT}/Include" 
    "${CMSIS_CORE}/CMSIS/Core/Include"
    "${CMSIS_CORE}/CMSIS/DSP/Include"
)

file(GLOB_RECURSE TFLM_SOURCES 
    "${TFLM_ROOT}/tensorflow/lite/micro/*.cc"
    "${TFLM_ROOT}/tensorflow/lite/micro/*.c"
    "${TFLM_ROOT}/tensorflow/lite/kernels/*.cc"
    "${TFLM_ROOT}/tensorflow/lite/kernels/*.c"
    "${TFLM_ROOT}/tensorflow/lite/kernels/internal/*.cc"
    "${TFLM_ROOT}/tensorflow/lite/kernels/internal/*.c"
    "${TFLM_ROOT}/tensorflow/lite/core/*.cc"
    "${TFLM_ROOT}/tensorflow/lite/core/*.c"
    "${TFLM_ROOT}/tensorflow/lite/schema/*.cc"
)

list(FILTER TFLM_SOURCES EXCLUDE REGEX "test.cc$")
list(FILTER TFLM_SOURCES EXCLUDE REGEX "mock")
list(FILTER TFLM_SOURCES EXCLUDE REGEX "bench")
list(FILTER TFLM_SOURCES EXCLUDE REGEX "_test_")
list(FILTER TFLM_SOURCES EXCLUDE REGEX "integration_tests")
list(FILTER TFLM_SOURCES EXCLUDE REGEX "examples")
list(FILTER TFLM_SOURCES EXCLUDE REGEX "test_data_generation") 
list(FILTER TFLM_SOURCES EXCLUDE REGEX "/tools/")
list(FILTER TFLM_SOURCES EXCLUDE REGEX "/python/")
list(FILTER TFLM_SOURCES EXCLUDE REGEX "/downloads/")

list(FILTER TFLM_SOURCES EXCLUDE REGEX "/kernels/add.cc")
list(FILTER TFLM_SOURCES EXCLUDE REGEX "/kernels/conv.cc")
list(FILTER TFLM_SOURCES EXCLUDE REGEX "/kernels/depthwise_conv.cc")
list(FILTER TFLM_SOURCES EXCLUDE REGEX "/kernels/fully_connected.cc")
list(FILTER TFLM_SOURCES EXCLUDE REGEX "/kernels/pooling.cc")
list(FILTER TFLM_SOURCES EXCLUDE REGEX "/kernels/softmax.cc")
list(FILTER TFLM_SOURCES EXCLUDE REGEX "/kernels/mul.cc")
list(FILTER TFLM_SOURCES EXCLUDE REGEX "/kernels/svdf.cc")
list(FILTER TFLM_SOURCES EXCLUDE REGEX "/kernels/transpose_conv.cc")
list(FILTER TFLM_SOURCES EXCLUDE REGEX "/kernels/unidirectional_sequence_lstm.cc")
list(FILTER TFLM_SOURCES EXCLUDE REGEX "/kernels/ethos_u/")
list(FILTER TFLM_SOURCES EXCLUDE REGEX "/kernels/hexagon/")
list(FILTER TFLM_SOURCES EXCLUDE REGEX "/kernels/xtensa/")
list(FILTER TFLM_SOURCES EXCLUDE REGEX "/kernels/arc_")
list(FILTER TFLM_SOURCES EXCLUDE REGEX "/kernels/ceva/")
list(FILTER TFLM_SOURCES EXCLUDE REGEX "ceva")
list(FILTER TFLM_SOURCES EXCLUDE REGEX "arc_")
list(FILTER TFLM_SOURCES EXCLUDE REGEX "bluepill")
list(FILTER TFLM_SOURCES EXCLUDE REGEX "chre")
list(FILTER TFLM_SOURCES EXCLUDE REGEX "riscv")
list(FILTER TFLM_SOURCES EXCLUDE REGEX "xtensa")
list(FILTER TFLM_SOURCES EXCLUDE REGEX "apollo3")
list(FILTER TFLM_SOURCES EXCLUDE REGEX "stm32")
list(FILTER TFLM_SOURCES EXCLUDE REGEX "himax")
list(FILTER TFLM_SOURCES EXCLUDE REGEX "esp")
list(FILTER TFLM_SOURCES EXCLUDE REGEX "hexagon")
list(FILTER TFLM_SOURCES EXCLUDE REGEX "cortex_m_corstone_300")
list(FILTER TFLM_SOURCES EXCLUDE REGEX "cortex_m_generic")

target_sources(app PRIVATE 
    src/main.c 
    src/dsp.c 
    src/inference.cpp
    src/model.cpp
    src/data.c
    ${TFLM_SOURCES}
)

target_compile_definitions(app PRIVATE 
    CMSIS_NN 
    TF_LITE_STATIC_MEMORY
)
```

## prj.conf
```kconfig
CONFIG_GPIO=y
CONFIG_SERIAL=y
CONFIG_LOG=y
CONFIG_PRINTK=y

CONFIG_CPP=y
CONFIG_STD_CPP17=y
CONFIG_GLIBCXX_LIBCPP=y
CONFIG_NEWLIB_LIBC=y
CONFIG_FPU=y

CONFIG_SPEED_OPTIMIZATIONS=y
CONFIG_COMPILER_OPT="-O3"

CONFIG_CMSIS_NN=y
CONFIG_CMSIS_NN_ACTIVATION=y
CONFIG_CMSIS_NN_CONVOLUTION=y
CONFIG_CMSIS_NN_FULLYCONNECTED=y
CONFIG_CMSIS_NN_BASICMATH=y
CONFIG_CMSIS_DSP_COMPLEXMATH=y
CONFIG_CMSIS_NN_POOLING=y
CONFIG_CMSIS_NN_SOFTMAX=y

CONFIG_CMSIS_DSP=y
CONFIG_CMSIS_DSP_FASTMATH=y
CONFIG_CMSIS_DSP_TRANSFORM=y
CONFIG_CMSIS_DSP_DISTANCE=y

CONFIG_HEAP_MEM_POOL_SIZE=4096
CONFIG_MAIN_STACK_SIZE=16384

CONFIG_HEAP_MEM_POOL_SIZE=16384
CONFIG_MAIN_STACK_SIZE=8192
CONFIG_SYSTEM_WORKQUEUE_STACK_SIZE=4096

# CONFIG_WIFI=y
# CONFIG_NETWORKING=y
# CONFIG_NET_L2_ETHERNET=y
# CONFIG_NET_IPV4=y
# CONFIG_NET_DHCPV4=y
# CONFIG_NET_UDP=y
# CONFIG_NET_SOCKETS=y

# CONFIG_NET_TX_STACK_SIZE=2048
# CONFIG_NET_RX_STACK_SIZE=2048
# CONFIG_NET_MGMT=y
# CONFIG_NET_MGMT_EVENT=y

# CONFIG_NET_PKT_RX_COUNT=8
# CONFIG_NET_PKT_TX_COUNT=8
# CONFIG_NET_BUF_RX_COUNT=8
# CONFIG_NET_BUF_TX_COUNT=8
```

## src/main.c
```c
#include <zephyr/kernel.h>
#include <zephyr/sys/printk.h>
#include <zephyr/drivers/gpio.h>
#include <stdlib.h>

#include "data.h"       
#include "dsp.h"        
#include "inference.h"  
#include "model.h"     
#include <hal/nrf_cache.h> 

#define CONFIDENCE_THRESHOLD 75 // setting to determine how confident it has to be to take action
#define SIGNAL_NOISE_FLOOR  2.0f 

#ifdef ENABLE_WIFI_TELEMETRY // macro for later when I add WiFi
    #include <zephyr/net/net_if.h>
    #include <zephyr/net/wifi_mgmt.h>
    #include <zephyr/net/net_event.h>
    #include <zephyr/net/net_mgmt.h>
    #include <zephyr/net/socket.h>
    #include "wifi_credentials.h"
#endif

// device tree with zephyr to automatically find the gpios
static const struct gpio_dt_spec led_target = GPIO_DT_SPEC_GET(DT_ALIAS(led0), gpios); // indication of detected correct sound
static const struct gpio_dt_spec pin_debug  = GPIO_DT_SPEC_GET(DT_ALIAS(led1), gpios); // indication of inference

// static and global variables to avoid putting on stack, and using aligned(16) for the ARM Cortex-M33 processor
int16_t audio_buffer[NUM_SAMPLES] __attribute__((aligned(16))); 
static float features_buffer[SPECTROGRAM_SIZE] __attribute__((aligned(16)));

#ifdef ENABLE_WIFI_TELEMETRY
    static struct net_mgmt_event_callback wifi_cb;
    static struct net_mgmt_event_callback net_cb;
    static K_SEM_DEFINE(wifi_connected_sem, 0, 1);
    static K_SEM_DEFINE(ipv4_obtained_sem, 0, 1);
    static int telemetry_sock = -1;

    static void wifi_mgmt_event_handler(struct net_mgmt_event_callback *cb,
                                        uint32_t mgmt_event, struct net_if *iface)
    {
        const struct wifi_status *status = (const struct wifi_status *)cb->info;
        if (status->status) {
            printk("[WiFi] Connection Error: %d\n", status->status);
        } else {
            printk("[WiFi] Connected. Requesting DHCP...\n");
            k_sem_give(&wifi_connected_sem);
        }
    }

    static void net_mgmt_event_handler(struct net_mgmt_event_callback *cb,
                                       uint32_t mgmt_event, struct net_if *iface)
    {
        if (mgmt_event == NET_EVENT_IPV4_ADDR_ADD) {
            printk("[WiFi] IPv4 Address Obtained.\n");
            k_sem_give(&ipv4_obtained_sem);
        }
    }

    void setup_udp_socket(void) {
        telemetry_sock = zsock_socket(AF_INET, SOCK_DGRAM, IPPROTO_UDP);
        if (telemetry_sock < 0) {
            printk("[Telemetry] Failed to create socket\n");
        }
    }

    void send_telemetry_event(const char* msg) {
        if (telemetry_sock < 0) return;

        struct sockaddr_in dest_addr;
        dest_addr.sin_family = AF_INET;
        dest_addr.sin_port = htons(TELEMETRY_PORT);
        zsock_inet_pton(AF_INET, TELEMETRY_IP, &dest_addr.sin_addr);

        int ret = zsock_sendto(telemetry_sock, msg, strlen(msg), 0,
                               (struct sockaddr *)&dest_addr, sizeof(dest_addr));
        if (ret < 0) {
            printk("[Telemetry] Send Failed\n");
        } else {
            printk("[Telemetry] Sent: %s\n", msg);
        }
    }

    void init_network_stack(void) {
        printk("Initializing Network Stack\n");
        net_mgmt_init_event_callback(&wifi_cb, wifi_mgmt_event_handler, NET_EVENT_WIFI_CONNECT_RESULT);
        net_mgmt_add_event_callback(&wifi_cb);
        net_mgmt_init_event_callback(&net_cb, net_mgmt_event_handler, NET_EVENT_IPV4_ADDR_ADD);
        net_mgmt_add_event_callback(&net_cb);

        struct net_if *iface = net_if_get_default();
        if (!iface) {
            printk("No network interface found\n");
            return;
        }

        struct wifi_connect_req_params params = {
            .ssid = WIFI_SSID,
            .ssid_length = strlen(WIFI_SSID),
            .psk = WIFI_PSK,
            .psk_length = strlen(WIFI_PSK),
            .security = WIFI_SECURITY_TYPE_PSK,
            .channel = WIFI_CHANNEL_ANY,
            .band = WIFI_FREQ_BAND_2_4_GHZ, 
            .mfp = WIFI_MFP_OPTIONAL
        };

        printk("Connecting to SSID: %s\n", WIFI_SSID);
        if (net_mgmt(NET_REQUEST_WIFI_CONNECT, iface, &params, sizeof(params))) {
            printk("Connection request failed\n");
            return;
        }

        if (k_sem_take(&wifi_connected_sem, K_SECONDS(20)) != 0) {
            printk("Connection timed out\n");
            return;
        }

        if (k_sem_take(&ipv4_obtained_sem, K_SECONDS(15)) != 0) {
            printk("DHCP timed out\n");
            return;
        }

        setup_udp_socket();
    }
#endif 

// digital injection, instead of microphone for more precise benchmarking and testing
void run_inference_test(const char* label, const int16_t* input_data, bool expect_target) {
    printk("\nTest: %s\n", label);

    if (input_data == NULL) {
        for(int i=0; i<NUM_SAMPLES; i++) audio_buffer[i] = (rand() % 10) - 5;
    } else {
        for(int i=0; i<NUM_SAMPLES; i++) audio_buffer[i] = input_data[i];
    }
    generate_spectrogram(audio_buffer, features_buffer);

    float peak_spectrogram = 0.0f;
    for(int i=0; i<SPECTROGRAM_SIZE; i++) {
        if(features_buffer[i] > peak_spectrogram) peak_spectrogram = features_buffer[i];
    }
    
    if (peak_spectrogram < SIGNAL_NOISE_FLOOR) {
        printk("Skipping Inference: Signal below noise floor (Max: %d)\n", (int)peak_spectrogram);
        return; 
    }


    gpio_pin_set_dt(&pin_debug, 1);
    uint32_t t_start = k_cycle_get_32();
    int confidence = run_inference(features_buffer);
    uint32_t t_end = k_cycle_get_32();
    
    gpio_pin_set_dt(&pin_debug, 0);

    uint32_t latency_ms = k_cyc_to_ms_ceil32(t_end - t_start);
    printk("Inference Time: %d ms | Confidence: %d%%\n", latency_ms, confidence);

    if (confidence > CONFIDENCE_THRESHOLD) {
        gpio_pin_set_dt(&led_target, 1);
        
        if (expect_target) {
            printk("Target Detected\n");
            #ifdef ENABLE_WIFI_TELEMETRY
            send_telemetry_event("KEYWORD_DETECTED_ON");
            #endif
        } else {
            printk("False Positive\n");
        }
    } else {
        gpio_pin_set_dt(&led_target, 0);
        if (expect_target) printk("False Negative\n");
        else printk("Correctly Ignored\n");
    }
}

int main(void)
{
    nrf_cache_enable(NRF_CACHE); // enabling instruction cache for performance
    if (!device_is_ready(led_target.port) || !device_is_ready(pin_debug.port)) return 0;
    gpio_pin_configure_dt(&led_target, GPIO_OUTPUT_ACTIVE);
    gpio_pin_configure_dt(&pin_debug, GPIO_OUTPUT_ACTIVE);
    gpio_pin_set_dt(&led_target, 0);
    gpio_pin_set_dt(&pin_debug, 0);

    printk("*** nRF5340: Edge AI KWS System ***\n");
    if (inference_setup() != 0) {
        printk("AI Initialization Failed\n");
        return 0;
    }
    printk("AI Initialized\n");

    #ifdef ENABLE_WIFI_TELEMETRY
    init_network_stack();
    #endif

    while (1) { // low power idle state in the loop with the RTOS scheduler
        run_inference_test("Silence", NULL, false);
        k_msleep(2000);
        
        run_inference_test("Interference (Cat)", audio_cat2, false);
        k_msleep(2000);
        
        run_inference_test("Target (ON)", audio_on2, true);
        k_msleep(2000);
    }
    return 0;
}
```

## include/inference.h
```c
#ifndef INFERENCE_H
#define INFERENCE_H

#ifdef __cplusplus
extern "C" {
#endif
int inference_setup(void);
int run_inference(float* spectrogram_data);
#ifdef __cplusplus
}
#endif

#endif 
```

## src/dsp.c
```c
#include "dsp.h"
#include "data.h"          
#include "mel_constants.h" 

#include <zephyr/kernel.h>
#include <arm_math.h>      
#include <math.h>          

// aliogned(16) for SIMD instructions
// matching python training configuration
static float fft_input_buffer[FFT_SIZE] __attribute__((aligned(16)));
static float fft_output_buffer[FFT_SIZE] __attribute__((aligned(16)));
static float fft_magnitude_buffer[NUM_FFT_BINS] __attribute__((aligned(16)));

static float window_func[FFT_SIZE] __attribute__((aligned(16)));
static arm_rfft_fast_instance_f32 fft_instance;
static bool is_initialized = false;

void dsp_init(void) {
    if (!is_initialized) {
        arm_rfft_fast_init_f32(&fft_instance, FFT_SIZE);
        for (int i =0; i < FFT_SIZE; i++) {
            window_func[i] = 0.5f - 0.5f *arm_cos_f32(2.0f * PI * (float)i / (float)FFT_SIZE);
        }

        is_initialized = true;
    }
}

int generate_spectrogram(const int16_t* audio_in, float* features_out) {
    if (!is_initialized) dsp_init();

    int read_index = 0; 
    int write_index = 0; 

    for (int i = 0; i < SPECTROGRAM_ROWS; i++) {
        for (int j = 0; j < FFT_SIZE; j++) {
            if (read_index + j < NUM_SAMPLES) {
                // dividing by 32768 for neural network to work with ranges between -1 and 1
                float normalized = (float)audio_in[read_index + j] / 32768.0f;
                fft_input_buffer[j] = normalized * window_func[j]; // smoothing edges to avoid spectral leakage
            } else {
                fft_input_buffer[j] = 0.0f;
            }
        }
        /*
        the output is symmetrical because the input is real numbers (audio)
        so arm_rfft_fast_f32 deletes second half and then the dc and nyquist frequencies
        gets packed as they are purely real numbers
        */ 
        arm_rfft_fast_f32(&fft_instance, fft_input_buffer, fft_output_buffer, 0);

        float dc = fft_output_buffer[0];
        fft_magnitude_buffer[0] = (dc>= 0) ? dc : -dc; 
        float nyquist = fft_output_buffer[1];
        fft_magnitude_buffer[NUM_FFT_BINS - 1] = (nyquist >= 0) ? nyquist : -nyquist; 
        arm_cmplx_mag_f32(fft_output_buffer +2, fft_magnitude_buffer + 1, NUM_FFT_BINS - 2);

        for (int m = 0; m < NUM_MEL_BINS; m++) {
            float energy_sum = 0.0f;
            
            for (int k = 0; k < NUM_FFT_BINS; k++) {
                energy_sum += fft_magnitude_buffer[k] * mel_filterbank[k][m];
            }
            // adding 1e-6f to prevent log(0)
            features_out[write_index++] = logf(energy_sum + 1e-6f);
        }

        read_index += WINDOW_STEP;
    }

    return 0;
}
```

## src/inference.cpp
```c
#include "inference.h"
#include <zephyr/kernel.h>
#include <zephyr/sys/printk.h>

#include "tensorflow/lite/micro/micro_mutable_op_resolver.h"
#include "tensorflow/lite/micro/micro_interpreter.h"
#include "tensorflow/lite/micro/system_setup.h"
#include "tensorflow/lite/schema/schema_generated.h"
#include "model.h" 

const tflite::Model* model = nullptr;
tflite::MicroInterpreter* interpreter = nullptr;
//statically allocate memory, so that it doesn't crash
const int kTensorArenaSize = 165 * 1024; // 165 as AllocateTensors() kept failing for having too low buffer
static uint8_t tensor_arena[kTensorArenaSize] __attribute__((aligned(16))); 

static TfLiteTensor* model_input = nullptr;
static TfLiteTensor* model_output = nullptr;

extern "C" int inference_setup(void) {
    model = tflite::GetModel(g_model);
    if (model->version() != TFLITE_SCHEMA_VERSION) {
        printk("Model schema version mismatch\n"); // checks if model trained in python is compatible with the tflm 
        return -1;
    }

    static tflite::MicroMutableOpResolver<15> micro_op_resolver; // using specific math functions to save memory rather than including all 
    micro_op_resolver.AddConv2D();
    micro_op_resolver.AddDepthwiseConv2D();
    micro_op_resolver.AddMaxPool2D();
    micro_op_resolver.AddFullyConnected();
    micro_op_resolver.AddSoftmax();
    micro_op_resolver.AddReshape();
    micro_op_resolver.AddAveragePool2D();
    micro_op_resolver.AddMul();
    micro_op_resolver.AddAdd();
    micro_op_resolver.AddMean();
    micro_op_resolver.AddQuantize();
    micro_op_resolver.AddDequantize();

    static tflite::MicroInterpreter static_interpreter(
        model, micro_op_resolver, tensor_arena, kTensorArenaSize);
    interpreter = &static_interpreter;
    
    if (interpreter->AllocateTensors() != kTfLiteOk) {
        printk("Arena too small for this model architecture\n");
        return -1;
    }

    model_input = interpreter->input(0);
    model_output = interpreter->output(0);

    if (model_input == nullptr || model_output == nullptr) {
        printk("Tensors are NULL\n");
        return -1; // stops program as it would crash
    }
    
    return 0;
}

extern "C" int run_inference(float* spectrogram_data) {
    if (model_input == nullptr || model_output == nullptr) return -1;
    int num_elements = model_input->bytes; 
    // quantization as the dsp speaks in floats 32 bit, and the ai model 8-bit integers
    // mapping numbers
    for (int i = 0; i <num_elements; i++) {
        float val = spectrogram_data[i];
        int8_t q_val = (int8_t)(val /model_input->params.scale + model_input->params.zero_point);
        model_input->data.int8[i] = q_val;
    }

    if (interpreter->Invoke() != kTfLiteOk) {
        printk("Interpreter Invoke failed\n"); // check to see if the math ran correctly 
        return -1;
    }
    // dequantization, outputs an integer and converts back to float for probability
    float probability = (model_output->data.int8[2] - model_output->params.zero_point) * model_output->params.scale;
    // return probability so that main can handle it
    return (int)(probability * 100.0f);
}
```
